/****************************************************************************************************
 *File		:	CMControl.c
 *Author	:  @YangTianhao ,490999282@qq.com，@TangJiaxin ,tjx1024@126.com
 *Version	: V1.0
 *Update	: 2017.12.11
 *Description: 	Control Chassis Motors.
								CMControlLoop() shows the way to control the motion of chassis in different states.
                Use PID to optimize Chassis motor control.
 *****************************************************************************************************/

#include "main.h"

int16_t CMFollowVal=0; 			    //底盘跟随值
int16_t speedA_final,speedB_final,speedC_final,speedD_final;
//PID_Struct CMPid,CMFollowPid,CMFollowPid_speed;                 //底盘运动pid、跟随pid
float step=100,keymove_x=0,keymove_y=0,m=0,n=0,q=0;           //step-速度变化率  x-x轴方向变化值 y-y速度变化值;




u8 quick_spin_flag=0;
int16_t CMFollowVal_QUICK=0;


PID_Type SPFOLLOW,SPCHIASSISA,SPCHIASSISB,SPCHIASSISC,SPCHIASSISD,SPFOLLOW_SPEED;


float max_output_speed=600;

float singl_max=4000;
float speed_step=500;
float output_current_sum=0;

float spin_y=0;
float spin_x=0;

u8 climb_mode_flag=0;


float cm_normal_p=2.0;
float cm_normal_i=0.8;
float cm_normal_d=0.2;

float cm_climb_p=8.5;
float cm_climb_i=20;
float cm_climb_d=0.0;

float rotate_speed=250;
int rotate_speed_dir=1;
float rotate_change_para=1;
int rotate_counter=0;
int rotate_counter_100ms=0;

/*************balance chiassis********/

/* parameters for PID controller */
float pp=180.0;
float pi=10.0;
float pd=5.0;
float sp=50;
float si=1.0;
float sd=3.0;


/* physical parameters of the balancing robot */
float M_bottom = 4;       // mass of the lower part of the chassis (kg)
float m_top = 2;          // mass of the upper part of the chassis (kg)
float b = 0.1;            // estimate of viscous friction coefficient (N-m-s)
float h = 0.25;           // length from top of the robot to line passing through the two wheels (m)
float I = 0.125;				  // moment of inertia of the pendulum (kg*m^2), estimated with I=(1/3)*(M+m)*h^2 or I=(1/3)*M*h^2
float g = 9.82;           // acceleration due to gravity (m/s^2)
float l = 0.20;           // length between the pendulum center of mass and the line passing through the two wheels (m)
float r = 0.075;          // wheel radius (m)
float k_T_F = 26.667;     // coefficient that, given a torque T, computes the linear force to the wheels F = k_T_F*T = (2/r)*T 


/* entries of the dynamics matrix (A) */
//contiguous time 2x2
//float A33 = 0;
//float A34 = 1;
//float A43 = 0;
//float A44 = 36.9312;
//contiguous time 3x3
//float A22 = -0.0279;
//float A23 = 1.1210;
//float A24 = 0;
//float A32 = 0;
//float A33 = 0;
//float A34 = 1;
//float A42 = -0.0457;
//float A43 = 17.9361;
//float A44 = 0;
//discrete time 2x2
//float A33 = 1.0018;
//float A34 = 0.01;
//float A43 = 0.3695;
//float A44 = 1.0018;
//discrete time 3x3
//float A22 = 1;
//float A23 = 0.0011;
//float A24 = 0;
//float A32 = 0;
//float A33 = 1;
//float A34 = 0.0010;
//float A42 = 0;	//before was -0.0457, but it was probably an error
//float A43 = 0.0179;
//float A44 = 0;
//discrete time 4x4 (linearization of nonlinear model)
float A11 = 1;
float A12 = 0.0010;
float A13 = 0;
float A14 = 0;
float A21 = 0;
float A22 = 1;
float A23 = 0.0015;
float A24 = 0;
float A31 = 0;
float A32 = 0;
float A33 = 1;
float A34 = 0.0010;
float A41 = 0;
float A42 = 0;
float A43 = 0.0220;
float A44 = 1;

/* entries of the inputs matrix (B) */
//contiguous time 2x1
//float B3 = 0;
//float B4 = 0.9402;
//contiguous time 3x1
//float B2 = 7.9583;
//float B3 = 0;
//float B4 = 13.0463;
//discrete time 2x1
//float B3 = 0;
//float B4 = 0.0094;
//discrete time 3x1
//float B2 = 0.0080;
//float B3 = 0;
//float B4 = 0.0130;
//discrete time 4x1 (linearization of nonlinear model)
float B1 = 0;
float B2 = 0.0249;
float B3 = 0;
float B4 = 0.0100;

/* entries of the outputs matrix (C) */
//Pitch and Pitch_gyro are measured from the sensors
//float C22 = 0;
//float C23 = 0;
//float C24 = 0;
//float C32 = 0;
//float C33 = 1;
//float C34 = 0;
//float C42 = 0;
//float C43 = 0;
//float C44 = 1;
//Pos and Pitch are measured from the sensors
float C11 = 1;
float C12 = 0;
float C13 = 0;
float C14 = 0;
float C31 = 0;
float C32 = 0;
float C33 = 1;
float C34 = 0;

/* initial entries of the Kalman filter matrix (Kf) */
//Pitch and Pitch_gyro are measured from the sensors, and Pos_dot is estimated
//float Kf23;
//float Kf24;
//float Kf33;
//float Kf34;
//float Kf43;
//float Kf44;
//Pos and Pitch are measured from the sensors, and Pos_dot and Pitch_gyro are estimated
float Kf11;
float Kf13;
float Kf21;
float Kf23;
float Kf31;
float Kf33;
float Kf41;
float Kf43;

/* initial entries of the error covariance matrix of 'x - x_estim' (P) */
//Pos_dot, Pitch and Pitch_gyro
//float P22 = 1;
//float P23 = 0;
//float P24 = 0;
//float P32 = 0;
//float P33 = 1;
//float P34 = 0;
//float P42 = 0;
//float P43 = 0;
//float P44 = 1;
//Pos, Pos_dot, Pitch and Pitch_gyro
float P11 = 1;
float P12 = 0;
float P13 = 0;
float P14 = 0;
float P21 = 0;
float P22 = 1;
float P23 = 0;
float P24 = 0;
float P31 = 0;
float P32 = 0;
float P33 = 1;
float P34 = 0;
float P41 = 0;
float P42 = 0;
float P43 = 0;
float P44 = 1;

/* entries of the predicted error covariance matrix of 'x - x_estim' (P_pred) */
//Pos_dot, Pitch and Pitch_gyro
//float P_pred22;
//float P_pred23;
//float P_pred24;
//float P_pred32;
//float P_pred33;
//float P_pred34;
//float P_pred42;
//float P_pred43;
//float P_pred44;
//Pos, Pos_dot, Pitch and Pitch_gyro
float P_pred11;
float P_pred12;
float P_pred13;
float P_pred14;
float P_pred21;
float P_pred22;
float P_pred23;
float P_pred24;
float P_pred31;
float P_pred32;
float P_pred33;
float P_pred34;
float P_pred41;
float P_pred42;
float P_pred43;
float P_pred44;

/* entries of the disturbance covariance matrix (Vd) */
float Vd11 = 0.1;
float Vd12 = 0;
float Vd13 = 0;
float Vd14 = 0;
float Vd21 = 0;
float Vd22 = 0.1;
float Vd23 = 0;
float Vd24 = 0;
float Vd31 = 0;
float Vd32 = 0;
float Vd33 = 0.1;
float Vd34 = 0;
float Vd41 = 0;
float Vd42 = 0;
float Vd43 = 0;
float Vd44 = 0.1;

/* entries of the noise covariance matrix (Vn) */
float Vn11 = 1;
float Vn12 = 0;
float Vn13 = 0;
float Vn14 = 0;
float Vn21 = 0;
float Vn22 = 1;
float Vn23 = 0;
float Vn24 = 0;
float Vn31 = 0;
float Vn32 = 0;
float Vn33 = 1;
float Vn34 = 0;
float Vn41 = 0;
float Vn42 = 0;
float Vn43 = 0;
float Vn44 = 1;

/* entries of the LQR gain (K) */
//float K3 = 79.1914;
//float K4 = 14.0874;
//float K3 = 62.9068;	//original value: 62.9068
//float K4 = 15.4891;	//original value: 9.4891
float K2 = -0.3533;
float K3 = 2.7285;
float K4 = 0.7700;

/* entries of 'tmp' matrix (matrix that temporarily stores values waiting to be used for other operations) */
float tmp11;
float tmp12;
float tmp13;
float tmp14;
float tmp21;
float tmp22;
float tmp23;
float tmp24;
float tmp31;
float tmp32;
float tmp33;
float tmp34;
float tmp41;
float tmp42;
float tmp43;
float tmp44;

/* entries of the matrix A*P*A^(T) (at every iteration of the Kalman Filter it gets computed from scratch) */
float APA11;
float APA12;
float APA13;
float APA14;
float APA21;
float APA22;
float APA23;
float APA24;
float APA31;
float APA32;
float APA33;
float APA34;
float APA41;
float APA42;
float APA43;
float APA44;

/* entries of the matrix C*P_prec*C^(T) (at every iteration of the Kalman Filter it gets computed from scratch) */
float CPC11;
float CPC12;
float CPC13;
float CPC14;
float CPC21;
float CPC22;
float CPC23;
float CPC24;
float CPC31;
float CPC32;
float CPC33;
float CPC34;
float CPC41;
float CPC42;
float CPC43;
float CPC44;

/* entries of the innovation covariance matrix (S) */
//Pitch and Pitch_gyro are measured by the sensors
//float S33;
//float S34;
//float S43;
//float S44;
//Pos and Pitch are measured by the sensors
float S11;
float S13;
float S31;
float S33;

/* entries of the inversed innovation covariance matrix (S^(-1)) */
//Pitch and Pitch_gyro are measured by the sensors
//float S_inv33;
//float S_inv34;
//float S_inv43;
//float S_inv44;
//Pos and Pitch are measured by the sensors
float S_inv11;
float S_inv13;
float S_inv31;
float S_inv33;

/* entries of the output prediction error array (delta_y) */
float delta_y1;
float delta_y2;
float delta_y3;
float delta_y4;

/* scalar variables */
float Pos_pred;									//balancing robot's linear position on the ground predicted by the Kalman filter
float Pos_dot_pred;							//balancing robot's linear velocity on the ground predicted by the Kalman filter
float Pitch_pred;								//balancing robot's angular position predicted by the Kalman filter
float Pitch_gyro_pred;					//balancing robot's angular velocity predicted by the Kalman filter
float Pos_estim = 0;
float Pos_dot_estim = 0;
float error_Pos;
float error_Pos_dot;
float error_Pitch;
float error_Pitch_gyro;
float S_det;										//used to store the determinant of the innovation matrix S
float input_to_wheel_L = 0;			//input sent to the wheels of balancing robot (to be used in Kalman Filter)
float input_to_wheel_R = 0;
float control_signal;
float control_signal_L;
float control_signal_R;
float control_signal_Pitch;
float control_signal_Pos_dot_L;
float control_signal_Pos_dot_R;
float Tcc = 0.001;							//inverse of the frequency of chassis controller (1000 Hz)
float cos_theta;								//cosine of the robot's angular position
float sin_theta;								//sine of the robot's angular position
float a_smc_Pitch;							//value a(x) used for SMC (Sliding Mode Control)
float b_smc_Pitch;							//value b(x) used for SMC (Sliding Mode Control)
float a_smc_Pos;
float b_smc_Pos;
float smc_conv_coeff = 0.1;			//convergence coefficient of the discrete-time sliding mode controller: |S(k+1)| <= smc_conv_coeff * |S(k)|
float ref_Pitch_prec = 0;				//previous reference signal for the robot's angular position
float ref_Pitch_gyro_prec = 0;	//previous reference signal for the robot's angular velocity
float ref_Pitch_succ;						//current reference signal for the robot's angular position
float ref_Pitch_gyro_succ;			//current reference signal for the robot's angular velocity
float ref_Pos_dot_L_prec;
float ref_Pos_dot_R_prec;
float ref_Pos_dot_L_succ;
float ref_Pos_dot_R_succ;
float k2 = 4;										//coeffient for the sliding function: S(k) = e_pitch_gyro(k) + k2*e_pitch(k)
float speedA_value;
float speedB_value;
float kalman_filter_results[4];
float Pitch_estim_L;
float Pitch_estim_R;
float Pitch_gyro_estim_L;
float Pitch_gyro_estim_R;
float Pos_estim_L;
float Pos_estim_R;
float Pos_dot_estim_L;
float Pos_dot_estim_R;


/* variables to contiguously track the position of the motors' encoder */
//int roundsCounter = 0;
//unsigned int completeCircleEncoderAngle = 8192;
//unsigned int currentEncoderAngle;
//unsigned int prevEncoderAngle = 0;
//long long int contiguousEncoderPos = 0;


/* variables for system identification */
int N = 1000;											//number of values that the arrays should contain
float Pitch_measurements[1000];				  //array of pitch position measurements
float Pitch_gyro_measurements[1000];		//array of pitch velocity measurements
float Pitch_estimations[1000];					//array of pitch position estimations
float Pitch_gyro_estimations[1000];			//array of pitch velocity estimations
float white_noise_input[1000];					//array of white noise sent to the wheels
unsigned int i = 0;								//counter for the arrays in which measurements are stored



//white noise for system identification
float white_noise[] = {-0.021462435950044094, -0.43024108996676325, 0.2790327699045845, -0.4975411489863535, -0.0015010968490626903, 0.04093844549228614, 0.22110687726320422, 0.8349236632792012, 0.31153551576182203, 0.8546019929033429, 0.12421344688981367, -0.3063627404066236, -0.6984516548351105,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 -0.6486390667578164, 
0.02525494960323248, 0.1586781962510419, 0.04431593645299289, -0.0006511374418752608, 0.18769741145803473, -0.005947744094402147, -0.5936532421728477, 0.3380495888544384, -0.2619232672734854, -0.28086848438921813, 0.17982967201926622, 0.7052483860486376,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 0.3486910538472998, 
-0.07171032168969797, 0.6941108727062448, 0.08303125560077368, -0.12892793082505835, 0.0991259092424132, 0.32817834106588034, -0.7168814535249, 0.4340432757685655, 0.5360805277647768, 
0.6021700295937219, -0.02178160094036343, -0.11456006134032021, -0.3585909771720713, 0.49059326139871695, -0.16940167012158283, 0.3146683922592162, 0.620765989521113, -0.059077661338398826, 0.08239296566862397, -0.002623062372050433, -0.5339112833971557,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 0.20692006309289762, 
-0.2293665036529868, 0.20955994491655405, -0.4759526474203411, 0.2298753839525357, 0.46730249443215155, 0.42893177667975624, 0.00979732874618227, -1.3006153947299604, 0.6467632106008838, -0.3250584721684623, 0.5156010054447563, 0.006911748480375863,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 0.20532780110106838, 
0.3416895950602687, -0.3537943166405581, 0.4123635476464691, 0.9970135089042191, -0.6589367321881675, -0.6922427235184935, -0.4219057239997872, -0.21687740427493896, -0.055278057786202844, -0.01593794012849185, -0.585735836875413, -0.10059997728967557,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 -0.455168896121432, 
0.6525853373221312, -0.5837393072637814, -1.2276999854385564, -0.6293566880466259, 1.0348822241830484, -0.4910651732258338, 0.25258192850892386, -0.18889606472013323, -0.17430988996021882, -0.0549232280403156, 0.504514961309655, 0.10460469780306676,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 0.0964349939437318, 
-0.17505112611744514, -0.5668990010693972, -0.18185732818878975, -0.3495643370181467, -0.3556167650300933, -0.023543152417816928, -0.24456567404313267, 0.32705600835689874, 0.5315091395396957, 0.022427674049619373, -0.6104893484530556, -0.1913066868876083,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 0.07924572046481533, -0.19916272969716087};





float out_speedL=0;
float out_speedR=0;
int16_t speedL=0;
int16_t speedR=0;
	
int16_t	mantainPosEncoderL = 0;				//control signal to make the left wheel mantain its position on the ground
int16_t	mantainPosEncoderR = 0;				//control signal to make the right wheel mantain its position on the ground

GimbalPID ChassiPitchPID;
float CMbalanceVal=0;
/*-------------  底盘控制循环  -------------*/
void CMControlLoop(void)
{

    CM_Switch_Moni();
    if(remoteState == PREPARE_STATE)
    {
        CMControlOut(0,0,0,0);
    }
    else if(remoteState == NORMAL_REMOTE_STATE)
    {
      //CMFollowVal = followValCal(0);
      //move(RC_Ex_Ctl.rc.ch0/10.24,RC_Ex_Ctl.rc.ch1/5.12,CMFollowVal/*0.5f*(RC_Ex_Ctl.rc.ch2)*/);
			//CMbalanceVal = caculate_balance(0.15*57.3);
			//move_balance(RC_Ex_Ctl.rc.ch1/5.12,0.5f*(RC_Ex_Ctl.rc.ch2),CMbalanceVal);
			
			/* NOTE: Kalman Filter has to be executed before than the LQR controller (think about the control system's block diagram) */
			//kalman_filter_update(input_to_wheels, Pitch - 0.28, Pitch_gyro);				// update the estimation of the balancing robot state
			kalman_filter_nonlinear_update(input_to_wheel_L, continuous_current_position_201*1, Pitch - 0.31);	// update the estimation of the balancing robot state
			Pos_estim_L = kalman_filter_results[0];
			Pos_dot_estim_L = kalman_filter_results[1];
			Pitch_estim_L = kalman_filter_results[2];
			Pitch_gyro_estim_L = kalman_filter_results[3];
			kalman_filter_nonlinear_update(input_to_wheel_R, continuous_current_position_202*1, Pitch - 0.31);
			Pos_estim_R = kalman_filter_results[0];
			Pos_dot_estim_R = kalman_filter_results[1];
			Pitch_estim_R = kalman_filter_results[2];
			Pitch_gyro_estim_R = kalman_filter_results[3];
			Pitch_estim = (Pitch_estim_L + Pitch_estim_R) / 2;
			Pitch_gyro_estim = (Pitch_gyro_estim_L + Pitch_gyro_estim_R) / 2;
			//move_balance(RC_Ex_Ctl.rc.ch1,RC_Ex_Ctl.rc.ch0,CMbalanceVal);															// LQR controller
			sliding_mode_controller(RC_Ex_Ctl.rc.ch1,RC_Ex_Ctl.rc.ch0,CMbalanceVal);
    }
    else if(remoteState == STANDBY_STATE )
    {
        CMStop();
    }
    else if(remoteState == ERROR_STATE )
    {
        CMStop();
    }
    else if(remoteState == KEY_REMOTE_STATE )
    {
				CMStop();
    }
    else if(remoteState == VIEW_STATE )
    {
				CMStop();
    }


}


float NowPosition_b = 0;
float caculate_balance(float Setposition){
	// Setposition is measured in rad
	float balanceVal = 0;
	float NowPosition = Pitch*57.3;
	
	float NowSpeed = Pitch_gyro*57.3;
//	if (abs(NowPosition)<20){
//		PID_SetGains(&ChassiPitchPID.Position,pp*(1-abs(NowPosition)/20.0),pi,pd);
//	}else{
//		return 0;
//	}
	balanceVal = PID_ControllerDriver(&ChassiPitchPID.Position,Setposition,NowPosition);
//	balanceVal=PID_ControllerDriver(&ChassiPitchPID.Speed,balanceVal/5.0f,NowSpeed);
	return balanceVal;
//	history[history_pos]=PID_ControllerDriver(&ChassiPitchPID.Speed,balanceVal/5.0f,NowSpeed);
//	if (history_pos<49){
//		history_pos+=1;
//	}
//	else{
//		history_pos=0;
//	}
//	NowPosition_b=0;
//	for (int16_t i=0;i<50;i++){
//		//NowPosition +=history[i];
//		NowPosition_b +=history[i];
//	}
//	balanceVal = NowPosition_b/50;
//	return balanceVal;
		
}

//float sum_Pitch_estim = 0;
//float sum_Pitch_gyro_estim = 0;
float history[10]={0,0,0,0,0,0,0,0,0,0};
int16_t history_pos=0;

void move_balance(int16_t speedY, int16_t rad,int16_t balance){
//	float max_speed=0;
//	speedL = speedY + balance + rad;
//	speedR = -speedY - balance + rad;
//	
//	if(fabs(speedL)>max_speed)
//        max_speed=fabs(speedL);
//	if(fabs(speedR)>max_speed)
//			max_speed=fabs(speedR);
//	
//	if(max_speed>max_output_speed)
//	{
//		speedL*=max_output_speed/max_speed;
//		speedR*=max_output_speed/max_speed;
//	}
//	float now_Pitch =0;
//	if (abs(Pitch)>0.01){
//		now_Pitch=Pitch;
//	}
	
//	if (speedY == 0 && rad == 0) {
//		currentPosL = current_position_201;
//		if (precPosL - currentPosL > 4000) {
//			counterRoundsL += 1;
//		}
//		contiguousPosEncoderL = 
//	}
//	else {
//		
//		mantainPosEncoderL = 0;
//		mantainPosEncoderR = 0;
//	}
//	
//	current_position_202
	
	
	
	// LQR control algorithm
	error_Pitch = (0 - Pitch_estim);				// I deleted the *57.3, because the Pitch and Pitch_gyro have to influence the LQR as much as Pos_dot
	if (speedY != 0) {
		
		error_Pitch += (-speedY/1024.0)*0.1221;			// sets the Pitch target in order to go forward/backward
	}
	else if (rad == 0) {
		
//	error_Pitch += continuous_current_position_201*0.0005;			// sets the Pitch target in order to mantain the linear position on the ground
	}
	
	error_Pitch_gyro = (0 - Pitch_gyro_estim);
	
//	// Huber loss for Pitch
//	if (error_Pitch >= 0) {
//		if (error_Pitch < 0.12) error_Pitch *= error_Pitch;
//	}
//	else {
//		if (-error_Pitch < 0.12) error_Pitch *= error_Pitch;
//	}
//	
//	// Huber loss for Pitch_gyro
//	if (error_Pitch_gyro >= 0) {
//		if (error_Pitch_gyro < 0.12) error_Pitch_gyro *= error_Pitch_gyro;
//	}
//	else {
//		if (-error_Pitch_gyro < 0.12) error_Pitch_gyro *= error_Pitch_gyro;
//	}
	
	control_signal = error_Pitch*K3 + error_Pitch_gyro*K4;
	
	if (speedY == 0) {
		
		// enable the control of the linear velocity on the ground
		error_Pos_dot = (0 - Pos_dot_estim);
		control_signal += error_Pos_dot*K2;
		
		if (rad == 0) {
			
			// enable the control of the linear position on the ground
//			control_signal += continuous_current_position_201*0.005;
		}
		//else contiguousEncoderPos = 0;
	}
	//else contiguousEncoderPos = 0;
	
	control_signal *= 10000;
	
	speedL = control_signal;
	
	
	//theta reference without KF: 0.27
	//theta reference with KF: 0.28
//	speedL = 6*((0.28+(-speedY/1024.0)*0.1221-Pitch)*57.3*K3+(0-Pitch_gyro)*57.3*K4);		// LQR control algorithm
//	if (0.265 >= Pitch) {
//		if (0.265-Pitch < 0.12) speedL *= 1.2;
//	}
//	else {
//		if (Pitch-0.265 < 0.12) speedL *= 1.2;
//	}
//	speedL = MotorCurrentLegalize(speedL,5000);
	
	speedR = -speedL;

	CMControlOut(speedL+rad*2,speedR+rad*2,0,0);
	//CAN1_Send_Bottom(speedL,speedR,0,0); //to send the control signals directly to the wheels motors
}


void sliding_mode_controller(int16_t speedY, int16_t rad,int16_t balance){

//	current_position_202
	
	cos_theta = cos(Pitch_estim);
	sin_theta = sin(Pitch_estim);
	
	ref_Pitch_succ = 0 + (-speedY/1024.0)*(10*3.1415/180);					//0.1221 rad = (7 degrees)*pi/180 <- MAX inclination of the robot's angular position
	ref_Pitch_gyro_succ = 0;
	
	a_smc_Pitch = ((m_top*l*g*sin_theta)/(I+m_top*l*l) + ((m_top*l*cos_theta)*(-b*Pos_dot_estim - m_top*l*Pitch_gyro_estim*Pitch_gyro_estim*sin_theta))/((I+m_top*l*l)*(M_bottom+m_top))) / (1 - (m_top*l*cos_theta)*(m_top*l*cos_theta)/((I+m_top*l*l)*(M_bottom+m_top)));
	b_smc_Pitch = ((2*m_top*l*cos_theta)/((I+m_top*l*l)*(M_bottom+m_top)*r)) / (1 - (m_top*l*cos_theta)*(m_top*l*cos_theta)/((I+m_top*l*l)*(M_bottom+m_top)));
	
	control_signal_Pitch = (ref_Pitch_gyro_succ - Pitch_gyro_estim - Tcc*a_smc_Pitch + k2*(ref_Pitch_succ - Pitch_estim - Tcc*Pitch_gyro_estim) - smc_conv_coeff*((ref_Pitch_gyro_prec - Pitch_gyro_estim) + k2*(ref_Pitch_prec - Pitch_estim))) / (Tcc*b_smc_Pitch);
	
	ref_Pitch_prec = ref_Pitch_succ;
	ref_Pitch_gyro_prec = ref_Pitch_gyro_succ;
	
	
	
	//SMC for Pos_dot
	Pos_dot_estim_L = estimated_speed_201;
	Pos_dot_estim_R = estimated_speed_202;
	
	ref_Pos_dot_L_succ = - Pos_dot_estim_L*0.3;
	ref_Pos_dot_R_succ = - Pos_dot_estim_R*0.3;
	
	a_smc_Pos = (-b*(I + m_top*l*l)*Pos_dot_estim + m_top*m_top*l*l*g*cos_theta*sin_theta - m_top*l*(I + m_top*l*l)*Pitch_gyro_estim*Pitch_gyro_estim*sin_theta) / ((I - m_top*l*l)*(M_bottom + m_top) - (m_top*l*cos_theta)*(m_top*l*cos_theta));
	b_smc_Pos = (2/r) / ((I - m_top*l*l)*(M_bottom + m_top) - (m_top*l*cos_theta)*(m_top*l*cos_theta));
	
	control_signal_Pos_dot_L = (ref_Pos_dot_L_succ - Pos_dot_estim_L - Tcc*a_smc_Pos - smc_conv_coeff*(ref_Pos_dot_L_prec - Pos_dot_estim_L)) / (Tcc*b_smc_Pos);
	control_signal_Pos_dot_R = (ref_Pos_dot_R_succ - Pos_dot_estim_R - Tcc*a_smc_Pos - smc_conv_coeff*(ref_Pos_dot_R_prec - Pos_dot_estim_R)) / (Tcc*b_smc_Pos);
	
	ref_Pos_dot_L_prec = ref_Pos_dot_L_succ;
	ref_Pos_dot_R_prec = ref_Pos_dot_R_succ;
	
	
	
	if ((speedY < 0 && Pos_dot_estim > 0) || (speedY > 0 && Pos_dot_estim < 0)) {
		control_signal_Pos_dot_L *= 100;
		control_signal_Pos_dot_R *= 100;
	}
	
	//control_signal_balance = 0;
	control_signal_L = control_signal_Pitch + 0.1*control_signal_Pos_dot_L;	//0.01
	control_signal_R = control_signal_Pitch + 0.1*control_signal_Pos_dot_R;	//0.01
	
	control_signal_L *= 25;		//35
	control_signal_R *= 25;		//35
	
	if (speedY == 0 && rad == 0) {
		control_signal_L *= 1.3;	//1.3
		control_signal_R *= 1.3;	//1.3
	}
	
	speedL = control_signal_L;
	speedR = -control_signal_R;

	CMControlOut(speedL+rad*2,speedR+rad*2,0,0);
	//CAN1_Send_Bottom(speedL,speedR,0,0); //to send the control signals directly to the wheels motors
}


/***************************************************************************************
*Name     	: kalman_filter_update
*Function 	: estimates the angular position and velocity of the robot by its inputs and outputs
*Input    	: u (input to the robot at time k-1), y3 (robot's pitch position at time k), y4 (robot's pitch velocity at time k)
*Output   	: none (the function just updates the values of Pitch_estim and Pitch_gyro_estim, which are estimations of pitch position and velocity of the robot, respectively)
*Description: it implements a state-of-the-art algorithm to solve iteratively the Riccatti equation, hence to compute Kf (the Kalman Filter gain matrix) and to estimate the robot's state
****************************************************************************************/
//void kalman_filter_update(int16_t u, float y3, float y4)
//{
//	
//	/*Step 1: Prediction*/
//	// state prediction: x_pred(k) = A*x_estim(k-1) + B*u(k-1)
////	Pitch_pred = (A33*Pitch_estim + A34*Pitch_gyro_estim) + (B3*u);
////	Pitch_gyro_pred = (A43*Pitch_estim + A44*Pitch_gyro_estim) + (B4*u);
//	Pos_dot_pred = (A22*Pos_dot_estim + A23*Pitch_estim + A24*Pitch_gyro_estim) + (B2*u);
//	Pitch_pred = (A32*Pos_dot_estim + A33*Pitch_estim + A34*Pitch_gyro_estim) + (B3*u);
//	Pitch_gyro_pred = (A42*Pos_dot_estim + A43*Pitch_estim + A44*Pitch_gyro_estim) + (B4*u);
//	Pitch_gyro_pred = Pitch_gyro_pred*0.0001;
//	
//	//Taylor series of consine and sine of the previously estimated robot's angular position
////	cos_theta = 1 - (Pitch_estim*Pitch_estim)/2 + (Pitch_estim*Pitch_estim*Pitch_estim*Pitch_estim)/24 - (Pitch_estim*Pitch_estim*Pitch_estim*Pitch_estim*Pitch_estim*Pitch_estim)/720;
////	sin_theta = Pitch_estim - (Pitch_estim*Pitch_estim*Pitch_estim)/6 + (Pitch_estim*Pitch_estim*Pitch_estim*Pitch_estim*Pitch_estim)/120 - (Pitch_estim*Pitch_estim*Pitch_estim*Pitch_estim*Pitch_estim*Pitch_estim*Pitch_estim)/5040;
////  cos_theta = cos(Pitch_estim);
////  sin_theta = sin(Pitch_estim);
////	Pitch_pred = Pitch_estim + Tcc*Pitch_gyro_estim;
////	Pos_dot_pred = Pos_dot_estim + Tcc*(-b*(I+m_top*l*l)*Pos_dot_estim + m_top*m_top*l*l*g*cos_theta*sin_theta - m_top*l*(I+m_top*l*l)*Pitch_gyro_estim*Pitch_gyro_estim*sin_theta + (2/r)*u) / ((I+m_top*l*l)*(M_bottom+m_top) - (m_top*l*cos_theta)*(m_top*l*cos_theta));
////	Pitch_gyro_pred = Pitch_gyro_estim + Tcc*((m_top*l*g*sin_theta)/(I+m_top*l*l) + ((m_top*l*cos_theta)*(-b*Pos_dot_estim - m_top*l*Pitch_gyro_estim*Pitch_gyro_estim*sin_theta))/((I+m_top*l*l)*(M_bottom+m_top)) + ((2*m_top*l*cos_theta)/((I+m_top*l*l)*(M_bottom+m_top)*r))*u) / (1 - (m_top*l*cos_theta)*(m_top*l*cos_theta)/((I+m_top*l*l)*(M_bottom+m_top)));
//	
//	
//	
//	// compute the matrix A*P(k-1)*A^(T) and store it in the matrix 'tmp'
////	tmp33 = A33*P33 + A34*P43;
////	tmp34 = A33*P34 + A34*P44;
////	tmp43 = A43*P33 + A44*P43;
////	tmp44 = A43*P34 + A44*P44;
//	tmp22 = A22*P22 + A23*P32 + A24*P42;
//	tmp23 = A22*P23 + A23*P33 + A24*P43;
//	tmp24 = A22*P24 + A23*P34 + A24*P44;
//	tmp32 = A32*P22 + A33*P32 + A34*P42;
//	tmp33 = A32*P23 + A33*P33 + A34*P43;
//	tmp34 = A32*P24 + A33*P34 + A34*P44;
//	tmp42 = A42*P22 + A43*P32 + A44*P42;
//	tmp43 = A42*P23 + A43*P33 + A44*P43;
//	tmp44 = A42*P24 + A43*P34 + A44*P44;
//	// now 'tmp' stores the matrix A*P(k-1), so we can compute tmp*A^(T)
////	APA33 = tmp33*A33 + tmp34*A34;
////	APA34 = tmp33*A43 + tmp34*A44;
////	APA43 = tmp43*A33 + tmp44*A34;
////	APA44 = tmp43*A43 + tmp44*A44;
//	APA22 = tmp22*A22 + tmp23*A23 + tmp24*A24;
//	APA23 = tmp22*A32 + tmp23*A33 + tmp24*A34;
//	APA24 = tmp22*A42 + tmp23*A43 + tmp24*A44;
//	APA32 = tmp32*A22 + tmp33*A23 + tmp34*A24;
//	APA33 = tmp32*A32 + tmp33*A33 + tmp34*A34;
//	APA34 = tmp32*A42 + tmp33*A43 + tmp34*A44;
//	APA42 = tmp42*A22 + tmp43*A23 + tmp44*A24;
//	APA43 = tmp42*A32 + tmp43*A33 + tmp44*A34;
//	APA44 = tmp42*A42 + tmp43*A43 + tmp44*A44;
//	
//	// forecast error covariance: P_pred(k) = A*P(k-1)*A^(T) + Vd
////	P_pred33 = APA33 + Vd33;
////	P_pred34 = APA34 + Vd34;
////	P_pred43 = APA43 + Vd43;
////	P_pred44 = APA44 + Vd44;
//	P_pred22 = APA22 + Vd22;
//	P_pred23 = APA23 + Vd23;
//	P_pred24 = APA24 + Vd24;
//	P_pred32 = APA32 + Vd32;
//	P_pred33 = APA33 + Vd33;
//	P_pred34 = APA34 + Vd34;
//	P_pred42 = APA42 + Vd42;
//	P_pred43 = APA43 + Vd43;
//	P_pred44 = APA44 + Vd44;
//	
//	/*Step 2: Update predictions*/
//	// compute the matrix C*P_pred(k)*C^(T) and store it in the matrix 'tmp'
////	tmp33 = P_pred33*C33 + P_pred34*C34;
////	tmp34 = P_pred33*C43 + P_pred34*C44;
////	tmp43 = P_pred43*C33 + P_pred44*C34;
////	tmp44 = P_pred43*C43 + P_pred44*C44;
//	tmp23 = P_pred22*C32 + P_pred23*C33 + P_pred24*C34;
//	tmp24 = P_pred22*C42 + P_pred23*C43 + P_pred24*C44;
//	tmp33 = P_pred32*C32 + P_pred33*C33 + P_pred34*C34;
//	tmp34 = P_pred32*C42 + P_pred33*C43 + P_pred34*C44;
//	tmp43 = P_pred42*C32 + P_pred43*C33 + P_pred44*C34;
//	tmp44 = P_pred42*C42 + P_pred43*C43 + P_pred44*C44;
//	// now 'tmp' stores the matrix P_pred(k)*C^(T), and we can compute C*tmp
////	CPC33 = C33*tmp33 + C34*tmp43;
////	CPC34 = C33*tmp34 + C34*tmp44;
////	CPC43 = C43*tmp33 + C44*tmp43;
////	CPC44 = C43*tmp34 + C44*tmp44;
//	CPC33 = C32*tmp23 + C33*tmp33 + C34*tmp43;
//	CPC34 = C32*tmp24 + C33*tmp34 + C34*tmp44;
//	CPC43 = C42*tmp23 + C43*tmp33 + C44*tmp43;
//	CPC44 = C42*tmp24 + C43*tmp34 + C44*tmp44;
//	
//	// innovation covariance matrix: S(k) = C*P_pred(k)*C^(T) + Vn
//	S33 = CPC33 + Vn33;
//	S34 = CPC34 + Vn34;
//	S43 = CPC43 + Vn43;
//	S44 = CPC44 + Vn44;
//	
//	// compute the inverse of the 2x2 innovation matrix S(k)^(-1)
//	S_det = S33*S44 - S34*S43;
//	S_inv33 = S44/S_det;
//	S_inv34 = -S34/S_det;
//	S_inv43 = -S43/S_det;
//	S_inv44 = S33/S_det;
//	
//	// compute Kalman Filter gain matrix: Kf(k) = P_pred(k)*C^(T)*S(k)^(-1)
////	Kf33 = tmp33*S_inv33 + tmp34*S_inv43;
////	Kf34 = tmp33*S_inv34 + tmp34*S_inv44;
////	Kf43 = tmp43*S_inv33 + tmp44*S_inv43;
////	Kf44 = tmp43*S_inv34 + tmp44*S_inv44;
//	Kf23 = tmp23*S_inv33 + tmp24*S_inv43;
//	Kf24 = tmp23*S_inv34 + tmp24*S_inv44;
//	Kf33 = tmp33*S_inv33 + tmp34*S_inv43;
//	Kf34 = tmp33*S_inv34 + tmp34*S_inv44;
//	Kf43 = tmp43*S_inv33 + tmp44*S_inv43;
//	Kf44 = tmp43*S_inv34 + tmp44*S_inv44;
//	
//	// error between prediction's output and actual output: delta_y(k) = y(k) - C*x_pred(k)
//	delta_y3 = y3 - (C32*Pos_dot_pred + C33*Pitch_pred + C34*Pitch_gyro_pred);
//	delta_y4 = y4 - (C42*Pos_dot_pred + C43*Pitch_pred + C44*Pitch_gyro_pred);
//	
//	// state estimation by means of 'a posteriori' correction of the state prediction: x_estim(k) = x_pred(k) + Kf*delta_y(k)
////	Pitch_estim = Pitch_pred + (Kf33*delta_y3 + Kf34*delta_y4);
////	Pitch_estim = Pitch_estim*10;
////	Pitch_gyro_estim = Pitch_gyro_pred + (Kf43*delta_y3 + Kf44*delta_y4);
//	Pos_dot_estim = Pos_dot_pred + (Kf23*delta_y3 + Kf24*delta_y4);
//	Pitch_estim = Pitch_pred + (Kf33*delta_y3 + Kf34*delta_y4);
//	Pitch_gyro_estim = Pitch_gyro_pred + (Kf43*delta_y3 + Kf44*delta_y4);
//	
//	// compute the matrix I - Kf*C and store it in the matrix 'tmp'
////	tmp33 = 1 - (Kf33*C33 + Kf34*C43);
////	tmp34 = 0 - (Kf33*C34 + Kf34*C44);
////	tmp43 = 0 - (Kf43*C33 + Kf44*C43);
////	tmp44 = 1 - (Kf43*C34 + Kf44*C44);
//	tmp22 = 1 - (Kf23*C32 + Kf24*C42);
//	tmp23 = 0 - (Kf23*C33 + Kf24*C43);
//	tmp24 = 0 - (Kf23*C34 + Kf24*C44);
//	tmp32 = 0 - (Kf33*C32 + Kf34*C42);
//	tmp33 = 1 - (Kf33*C33 + Kf34*C43);
//	tmp34 = 0 - (Kf33*C34 + Kf34*C44);
//	tmp42 = 0 - (Kf43*C32 + Kf44*C42);
//	tmp43 = 0 - (Kf43*C33 + Kf44*C43);
//	tmp44 = 1 - (Kf43*C34 + Kf44*C44);
//	
//	// error covariance matrix estimation: P(k) = (I - Kf*C)*P_pred(k)
////	P33 = tmp33*P_pred33 + tmp34*P_pred43;
////	P34 = tmp33*P_pred34 + tmp34*P_pred44;
////	P43 = tmp43*P_pred33 + tmp44*P_pred43;
////	P44 = tmp43*P_pred34 + tmp44*P_pred44;
//	P22 = tmp22*P_pred22 + tmp23*P_pred32 + tmp24*P_pred42;
//	P23 = tmp22*P_pred23 + tmp23*P_pred33 + tmp24*P_pred43;
//	P24 = tmp22*P_pred24 + tmp23*P_pred34 + tmp24*P_pred44;
//	P32 = tmp32*P_pred22 + tmp33*P_pred32 + tmp34*P_pred42;
//	P33 = tmp32*P_pred23 + tmp33*P_pred33 + tmp34*P_pred43;
//	P34 = tmp32*P_pred24 + tmp33*P_pred34 + tmp34*P_pred44;
//	P42 = tmp42*P_pred22 + tmp43*P_pred32 + tmp44*P_pred42;
//	P43 = tmp42*P_pred23 + tmp43*P_pred33 + tmp44*P_pred43;
//	P44 = tmp42*P_pred24 + tmp43*P_pred34 + tmp44*P_pred44;
//	
//	
//	// collect both pitch position/velocity measurements and estimations, so that we can graph and compare them
////	if (i < N) {
////		
////		Pitch_measurements[i] = y3;
////		Pitch_gyro_measurements[i] = y4;
////		Pitch_estimations[i] = Pitch_estim;
////		Pitch_gyro_estimations[i] = Pitch_gyro_estim;
////		white_noise_input[i] = u;
////		
////		if (i == N-1) {
////			//save the arrays in separated files
////			
////			char *separator = "----------";
////			u8 *separator_u8 = (u8 *) separator;
////			
////			/*
////			u8 Pitch_measurements_u8[4000];
////			unsigned int jj = 0;
////			for(unsigned int j=0; j<1000; j++) {
////				int32_t tmp = (int32_t) Pitch_measurements[j]*10000000000;	//convert the first 10 fractional digits into integer digits, and then convert the number to int
////				Pitch_measurements_u8[jj] = tmp >> 24;
////				jj++;
////				Pitch_measurements_u8[jj] = tmp >> 16;
////				jj++;
////				Pitch_measurements_u8[jj] = tmp >> 8;
////				jj++;
////				Pitch_measurements_u8[jj] = tmp;
////				jj++;
////			}
////			*/
////			
////			u8 Pitch_measurements_u8[4000];
////			
////			for(unsigned int j=0; j<1000; j++) {
////				unsigned long longdata = 0;
////				longdata = *(unsigned long*)&Pitch_measurements[j];
////				Pitch_measurements_u8[4*j] = (longdata & 0xFF000000) >> 24;
////				Pitch_measurements_u8[4*j+1] = (longdata & 0x00FF0000) >> 16;
////				Pitch_measurements_u8[4*j+2] = (longdata & 0x0000FF00) >> 8;
////				Pitch_measurements_u8[4*j+3] = (longdata & 0x000000FF);
////			}
////			
////			for (unsigned int j=0; j<20; j++) {
////				UART3_Send(Pitch_measurements_u8+j*200, 200);
////			}
////			UART3_Send(separator_u8, 10);
////			
////		}
////		
////		i++;
////	}
//}


/***************************************************************************************
*Name     	: kalman_filter_nonlinear_update
*Function 	: estimates the angular position and velocity of the robot by its inputs and outputs, using a nonlinear model of the balancing robot
*Input    	: u (input to the robot at time k-1), y3 (robot's pitch position at time k), y4 (robot's pitch velocity at time k)
*Output   	: none (the function just updates the values of Pitch_estim and Pitch_gyro_estim, which are estimations of pitch position and velocity of the robot, respectively)
*Description: it implements a state-of-the-art algorithm to solve iteratively the Riccatti equation, hence to compute Kf (the Kalman Filter gain matrix) and to estimate the robot's state
****************************************************************************************/
void kalman_filter_nonlinear_update(int16_t u, float y1, float y3)
{
	
	//NOTE: we assume that the states observed are Pos and Pitch
	
	//Taylor series of consine and sine of the previously estimated robot's angular position
//	cos_theta = 1 - (Pitch_estim*Pitch_estim)/2 + (Pitch_estim*Pitch_estim*Pitch_estim*Pitch_estim)/24 - (Pitch_estim*Pitch_estim*Pitch_estim*Pitch_estim*Pitch_estim*Pitch_estim)/720;
//	sin_theta = Pitch_estim - (Pitch_estim*Pitch_estim*Pitch_estim)/6 + (Pitch_estim*Pitch_estim*Pitch_estim*Pitch_estim*Pitch_estim)/120 - (Pitch_estim*Pitch_estim*Pitch_estim*Pitch_estim*Pitch_estim*Pitch_estim*Pitch_estim)/5040;
  cos_theta = cos(Pitch_estim);
  sin_theta = sin(Pitch_estim);
	
	/*Step 1: Prediction*/
	// state prediction: x_pred(k) = A*x_estim(k-1) + B*u(k-1)
	
	Pos_pred = Pos_estim + Tcc*Pos_dot_estim;
	Pos_dot_pred = Pos_dot_estim - Tcc*(-b*(I+m_top*l*l)*Pos_dot_estim + m_top*m_top*l*l*g*cos_theta*sin_theta - m_top*l*(I+m_top*l*l)*Pitch_gyro_estim*Pitch_gyro_estim*sin_theta + (2/r)*u) / ((I+m_top*l*l)*(M_bottom+m_top) - (m_top*l*cos_theta)*(m_top*l*cos_theta));
	Pitch_pred = Pitch_estim + Tcc*Pitch_gyro_estim;
	Pitch_gyro_pred = Pitch_gyro_estim + Tcc*((m_top*l*g*sin_theta)/(I+m_top*l*l) + ((m_top*l*cos_theta)*(-b*Pos_dot_estim - m_top*l*Pitch_gyro_estim*Pitch_gyro_estim*sin_theta))/((I+m_top*l*l)*(M_bottom+m_top)) + ((2*m_top*l*cos_theta)/((I+m_top*l*l)*(M_bottom+m_top)*r))*u) / (1 - (m_top*l*cos_theta)*(m_top*l*cos_theta)/((I+m_top*l*l)*(M_bottom+m_top)));
	Pitch_gyro_pred = Pitch_gyro_pred*0.0001;
	
	
	// compute the matrix A*P(k-1)*A^(T) and store it in the matrix 'tmp'
	tmp11 = A11*P11 + A12*P21 + A13*P31 + A14*P41;
	tmp12 = A11*P12 + A12*P22 + A13*P32 + A14*P42;
	tmp13 = A11*P13 + A12*P23 + A13*P33 + A14*P43;
	tmp14 = A11*P14 + A12*P24 + A13*P34 + A14*P44;
	tmp21 = A21*P11 + A22*P21 + A23*P31 + A24*P41;
	tmp22 = A21*P12 + A22*P22 + A23*P32 + A24*P42;
	tmp23 = A21*P13 + A22*P23 + A23*P33 + A24*P43;
	tmp24 = A21*P14 + A22*P24 + A23*P34 + A24*P44;
	tmp31 = A31*P11 + A32*P21 + A33*P31 + A34*P41;
	tmp32 = A31*P12 + A32*P22 + A33*P32 + A34*P42;
	tmp33 = A31*P13 + A32*P23 + A33*P33 + A34*P43;
	tmp34 = A31*P14 + A32*P24 + A33*P34 + A34*P44;
	tmp41 = A41*P11 + A42*P21 + A43*P31 + A44*P41;
	tmp42 = A41*P12 + A42*P22 + A43*P32 + A44*P42;
	tmp43 = A41*P13 + A42*P23 + A43*P33 + A44*P43;
	tmp44 = A41*P14 + A42*P24 + A43*P34 + A44*P44;
	// now 'tmp' stores the matrix A*P(k-1), so we can compute tmp*A^(T)
	APA11 = tmp11*A11 + tmp12*A12 + tmp13*A13 + tmp14*A14;
	APA12 = tmp11*A21 + tmp12*A22 + tmp13*A23 + tmp14*A24;
	APA13 = tmp11*A31 + tmp12*A32 + tmp13*A33 + tmp14*A34;
	APA14 = tmp11*A41 + tmp12*A42 + tmp13*A43 + tmp14*A44;
	APA21 = tmp21*A11 + tmp22*A12 + tmp23*A13 + tmp24*A14;
	APA22 = tmp21*A21 + tmp22*A22 + tmp23*A23 + tmp24*A24;
	APA23 = tmp21*A31 + tmp22*A32 + tmp23*A33 + tmp24*A34;
	APA24 = tmp21*A41 + tmp22*A42 + tmp23*A43 + tmp24*A44;
	APA31 = tmp31*A11 + tmp32*A12 + tmp33*A13 + tmp34*A14;
	APA32 = tmp31*A21 + tmp32*A22 + tmp33*A23 + tmp34*A24;
	APA33 = tmp31*A31 + tmp32*A32 + tmp33*A33 + tmp34*A34;
	APA34 = tmp31*A41 + tmp32*A42 + tmp33*A43 + tmp34*A44;
	APA41 = tmp41*A11 + tmp42*A12 + tmp43*A13 + tmp44*A14;
	APA42 = tmp41*A21 + tmp42*A22 + tmp43*A23 + tmp44*A24;
	APA43 = tmp41*A31 + tmp42*A32 + tmp43*A33 + tmp44*A34;
	APA44 = tmp41*A41 + tmp42*A42 + tmp43*A43 + tmp44*A44;

	// forecast error covariance: P_pred(k) = A*P(k-1)*A^(T) + Vd
	P_pred11 = APA11 + Vd11;
	P_pred12 = APA12 + Vd12;
	P_pred13 = APA13 + Vd13;
	P_pred14 = APA14 + Vd14;
	P_pred21 = APA21 + Vd21;
	P_pred22 = APA22 + Vd22;
	P_pred23 = APA23 + Vd23;
	P_pred24 = APA24 + Vd24;
	P_pred31 = APA31 + Vd31;
	P_pred32 = APA32 + Vd32;
	P_pred33 = APA33 + Vd33;
	P_pred34 = APA34 + Vd34;
	P_pred41 = APA41 + Vd41;
	P_pred42 = APA42 + Vd42;
	P_pred43 = APA43 + Vd43;
	P_pred44 = APA44 + Vd44;
	
	/*Step 2: Update predictions*/
	// compute the matrix C*P_pred(k)*C^(T) and store it in the matrix 'tmp'
	tmp11 = P_pred11*C11 + P_pred12*C12 + P_pred13*C13 + P_pred14*C14;
	tmp13 = P_pred11*C31 + P_pred12*C32 + P_pred13*C33 + P_pred14*C34;
	tmp21 = P_pred21*C11 + P_pred22*C12 + P_pred23*C13 + P_pred24*C14;
	tmp23 = P_pred21*C31 + P_pred22*C32 + P_pred23*C33 + P_pred24*C34;
	tmp31 = P_pred31*C11 + P_pred32*C12 + P_pred33*C13 + P_pred34*C14;
	tmp33 = P_pred31*C31 + P_pred32*C32 + P_pred33*C33 + P_pred34*C34;
	tmp41 = P_pred41*C11 + P_pred42*C12 + P_pred43*C13 + P_pred44*C14;
	tmp43 = P_pred41*C31 + P_pred42*C32 + P_pred43*C33 + P_pred44*C34;
	// now 'tmp' stores the matrix P_pred(k)*C^(T), and we can compute C*tmp
	CPC11 = C11*tmp11 + C12*tmp21 + C13*tmp31 + C14*tmp41;
	CPC13 = C11*tmp13 + C12*tmp23 + C13*tmp33 + C14*tmp43;
	CPC31 = C31*tmp11 + C32*tmp21 + C33*tmp31 + C34*tmp41;
	CPC33 = C31*tmp13 + C32*tmp23 + C33*tmp33 + C34*tmp43;
	
	// innovation covariance matrix: S(k) = C*P_pred(k)*C^(T) + Vn
	S11 = CPC11 + Vn11;
	S13 = CPC13 + Vn13;
	S31 = CPC31 + Vn31;
	S33 = CPC33 + Vn33;
	
	// compute the inverse of the 2x2 innovation matrix S(k)^(-1)
	S_det = S11*S33 - S13*S31;
	S_inv11 = S33/S_det;
	S_inv13 = -S13/S_det;
	S_inv31 = -S31/S_det;
	S_inv33 = S11/S_det;
	
	// compute Kalman Filter gain matrix: Kf(k) = P_pred(k)*C^(T)*S(k)^(-1)
	Kf11 = tmp11*S_inv11 + tmp13*S_inv31;
	Kf13 = tmp11*S_inv13 + tmp13*S_inv33;
	Kf21 = tmp21*S_inv11 + tmp23*S_inv31;
	Kf23 = tmp21*S_inv13 + tmp23*S_inv33;
	Kf31 = tmp31*S_inv11 + tmp33*S_inv31;
	Kf33 = tmp31*S_inv13 + tmp33*S_inv33;
	Kf41 = tmp41*S_inv11 + tmp43*S_inv31;
	Kf43 = tmp41*S_inv13 + tmp43*S_inv33;
	
	// error between prediction's output and actual output: delta_y(k) = y(k) - C*x_pred(k)
	delta_y1 = y1 - (C11*Pos_pred + C12*Pos_dot_pred + C13*Pitch_pred + C14*Pitch_gyro_pred);
	delta_y3 = y3 - (C31*Pos_pred + C32*Pos_dot_pred + C33*Pitch_pred + C34*Pitch_gyro_pred);
	
	// state estimation by means of 'a posteriori' correction of the state prediction: x_estim(k) = x_pred(k) + Kf*delta_y(k)
	Pos_estim = Pos_pred + (Kf11*delta_y1 + Kf13*delta_y3);
	Pos_dot_estim = Pos_dot_pred + (Kf21*delta_y1 + Kf23*delta_y3);
	Pitch_estim = Pitch_pred + (Kf31*delta_y1 + Kf33*delta_y3);
	Pitch_gyro_estim = Pitch_gyro_pred + (Kf41*delta_y1 + Kf43*delta_y3);
	
	// compute the matrix I - Kf*C and store it in the matrix 'tmp'
	tmp11 = 1 - (Kf11*C11 + Kf13*C31);
	tmp12 = 0 - (Kf11*C12 + Kf13*C32);
	tmp13 = 0 - (Kf11*C13 + Kf13*C33);
	tmp14 = 0 - (Kf11*C14 + Kf13*C34);
	tmp21 = 0 - (Kf21*C11 + Kf23*C31);
	tmp22 = 1 - (Kf21*C12 + Kf23*C32);
	tmp23 = 0 - (Kf21*C13 + Kf23*C33);
	tmp24 = 0 - (Kf21*C14 + Kf23*C34);
	tmp31 = 0 - (Kf31*C11 + Kf33*C31);
	tmp32 = 0 - (Kf31*C12 + Kf33*C32);
	tmp33 = 1 - (Kf31*C13 + Kf33*C33);
	tmp34 = 0 - (Kf31*C14 + Kf33*C34);
	tmp41 = 0 - (Kf41*C11 + Kf43*C31);
	tmp42 = 0 - (Kf41*C12 + Kf43*C32);
	tmp43 = 0 - (Kf41*C13 + Kf43*C33);
	tmp44 = 1 - (Kf41*C14 + Kf43*C34);
	
	// error covariance matrix estimation: P(k) = (I - Kf*C)*P_pred(k)
	P11 = tmp11*P_pred11 + tmp12*P_pred21 + tmp13*P_pred31 + tmp14*P_pred41;
	P12 = tmp11*P_pred12 + tmp12*P_pred22 + tmp13*P_pred32 + tmp14*P_pred42;
	P13 = tmp11*P_pred13 + tmp12*P_pred23 + tmp13*P_pred33 + tmp14*P_pred43;
	P14 = tmp11*P_pred14 + tmp12*P_pred24 + tmp13*P_pred34 + tmp14*P_pred44;
	P21 = tmp21*P_pred11 + tmp22*P_pred21 + tmp23*P_pred31 + tmp24*P_pred41;
	P22 = tmp21*P_pred12 + tmp22*P_pred22 + tmp23*P_pred32 + tmp24*P_pred42;
	P23 = tmp21*P_pred13 + tmp22*P_pred23 + tmp23*P_pred33 + tmp24*P_pred43;
	P24 = tmp21*P_pred14 + tmp22*P_pred24 + tmp23*P_pred34 + tmp24*P_pred44;
	P31 = tmp31*P_pred11 + tmp32*P_pred21 + tmp33*P_pred31 + tmp34*P_pred41;
	P32 = tmp31*P_pred12 + tmp32*P_pred22 + tmp33*P_pred32 + tmp34*P_pred42;
	P33 = tmp31*P_pred13 + tmp32*P_pred23 + tmp33*P_pred33 + tmp34*P_pred43;
	P34 = tmp31*P_pred14 + tmp32*P_pred24 + tmp33*P_pred34 + tmp34*P_pred44;
	P41 = tmp41*P_pred11 + tmp42*P_pred21 + tmp43*P_pred31 + tmp44*P_pred41;
	P42 = tmp41*P_pred12 + tmp42*P_pred22 + tmp43*P_pred32 + tmp44*P_pred42;
	P43 = tmp41*P_pred13 + tmp42*P_pred23 + tmp43*P_pred33 + tmp44*P_pred43;
	P44 = tmp41*P_pred14 + tmp42*P_pred24 + tmp43*P_pred34 + tmp44*P_pred44;
	
	kalman_filter_results[0] = Pos_estim;
	kalman_filter_results[1] = Pos_dot_estim;
	kalman_filter_results[2] = Pitch_estim;
	kalman_filter_results[3] = Pitch_gyro_estim;
}	






//void computeContiguousEncoderPos(void) {
//	
//	currentEncoderAngle = current_position_201;
//	if (prevEncoderAngle - currentEncoderAngle > completeCircleEncoderAngle/2) roundsCounter++;
//	else if (currentEncoderAngle - prevEncoderAngle > completeCircleEncoderAngle/2) roundsCounter--;
//	
//	contiguousEncoderPos = currentEncoderAngle + roundsCounter*completeCircleEncoderAngle;
//	
//	prevEncoderAngle = currentEncoderAngle;
//}




/*-------------  底盘停止  -------------*/
void CMStop(void)
{
    CAN1_Send_Bottom(0,0,0,0);
}


/***************************************************************************************
 *Name     : move
 *Function ：计算底盘电机速度给定值 由遥控器控制。同时有各个轮子的速度限制
 *Input    ：speedX, speedY, rad
 *Output   ：无
 *Description :改变了全局变量	speedA, speedB, speedC, speedD
****************************************************************************************/
void move(int16_t speedX, int16_t speedY, int16_t rad)
{
    float max_speed=0;
    speedX *= gears_speedXYZ;
    speedY *= gears_speedXYZ;
    rad *= gears_speedRAD;


//		if(fabs(speedY)>6000&&fabs(rad)<100)
//		{
//			rad*=10;
//		}

    int16_t speedA = ( speedX + speedY + rad);
    int16_t speedB = ( speedX - speedY + rad);
    int16_t speedC = (-speedX - speedY + rad);
    int16_t speedD = (-speedX + speedY + rad);

    if(fabs(speedA)>max_speed)
        max_speed=fabs(speedA);
    if(fabs(speedB)>max_speed)
        max_speed=fabs(speedB);
    if(fabs(speedC)>max_speed)
        max_speed=fabs(speedC);
    if(fabs(speedD)>max_speed)
        max_speed=fabs(speedD);

    if(max_speed>max_output_speed)
    {
        speedA*=max_output_speed/max_speed;
        speedB*=max_output_speed/max_speed;
        speedC*=max_output_speed/max_speed;
        speedD*=max_output_speed/max_speed;
    }

    CMControlOut(speedA,speedB,speedC,speedD);
}


void key_move(int16_t speedX, int16_t speedY, int16_t rad)
{
    float max_speed=0;
    rad *= gears_speedRAD;

    if(fabs(speedY)>5000&&fabs(rad)<50&&fabs(rad)>5)
    {
        rad*=10;
    }
    int16_t speedA = ( speedX + speedY + rad);
    int16_t speedB = ( speedX - speedY + rad);
    int16_t speedC = (-speedX - speedY+ rad);
    int16_t speedD = (-speedX + speedY + rad);

    if(fabs(speedA)>max_speed)
        max_speed=fabs(speedA);
    if(fabs(speedB)>max_speed)
        max_speed=fabs(speedB);
    if(fabs(speedC)>max_speed)
        max_speed=fabs(speedC);
    if(fabs(speedD)>max_speed)
        max_speed=fabs(speedD);

    if(max_speed>max_output_speed)
    {
        speedA*=max_output_speed/max_speed;
        speedB*=max_output_speed/max_speed;
        speedC*=max_output_speed/max_speed;
        speedD*=max_output_speed/max_speed;
    }

    CMControlOut(speedA,speedB,speedC,speedD);
}



/***************************************************************************************
 *Name     : CMControlOut
 *Function ：底盘电机速度输出，经过PID控制器，发送给电机驱动器，同时有各个轮子的速度限制
 *Input    ：speedA,speedB,speedC,speedD
 *Output   ：无
 *Description : 底盘电机速度环和幅值函数
****************************************************************************************/
int16_t out_a=0;
float lec_numA=3000;
float lec_numB=3000;
float lec_numC=3000;
float lec_numD=3000;

int16_t pre_current_A=0;
int16_t pre_current_B=0;
int16_t pre_current_C=0;
int16_t pre_current_D=0;
int16_t current_step=600;//80;
u8 super_cap_flag=0;
void CMControlOut(int16_t spa , int16_t spb ,int16_t spc ,int16_t spd )
{

    float current_sum=0;
    int max_now_speed=0;
	
    float speedA = PID_ControllerDriver(&SPCHIASSISA,spa,current_cm_201);
    float speedB = PID_ControllerDriver(&SPCHIASSISB,spb,current_cm_202);
    float speedC = PID_ControllerDriver(&SPCHIASSISC,spc,current_cm_203);
    float speedD = PID_ControllerDriver(&SPCHIASSISD,spd,current_cm_204);
		
		/* Recovering the input sent to wheels, so that it can be used in the Kalman Filter.
		* The input sent to the motor's speed controller is in the range [-16384, +16384], which corresponds to
		* a current range of [-20A, +20A]. The motor then produces a torque that is proportional to the
		* received current and based on its Torque Constant Km = 0.741 N*m/A */
	speedA_value = speedA;	
	speedB_value = speedB;	
	input_to_wheel_L = (speedA*20/16384)*0.741;		//measurement unit: torque [N*m]
	input_to_wheel_R = (speedB*20/16384)*0.741;		//measurement unit: torque [N*m]
	
   // if(cap_receive.state_module==Cap_Run&&cap_receive.state_cap==Cap_Boost&&cap_receive.CapVol>11800)
    if(1)
    {
        CAN1_Send_Bottom(speedA,speedB,speedC,speedD);
        super_cap_flag=0;
    }
    else
    {
        super_cap_flag=1;
        if(abs(current_cm_201)>max_now_speed)
            max_now_speed=abs(current_cm_201);
        if(abs(current_cm_202)>max_now_speed)
            max_now_speed=abs(current_cm_202);
        if(abs(current_cm_203)>max_now_speed)
            max_now_speed=abs(current_cm_203);
        if(abs(current_cm_204)>max_now_speed)
            max_now_speed=abs(current_cm_204);


        if(abs(speedA-pre_current_A)>current_step)
        {
            if(speedA-pre_current_A>current_step)
                speedA=pre_current_A+current_step;
            else if(speedA-pre_current_A<-current_step)
                speedA=pre_current_A-current_step;
        }

        if(abs(speedB-pre_current_B)>current_step)
        {
            if(speedB-pre_current_B>current_step)
                speedB=pre_current_B+current_step;
            else if(speedB-pre_current_B<-current_step)
                speedB=pre_current_B-current_step;
        }
        if(abs(speedC-pre_current_C)>current_step)
        {
            if(speedC-pre_current_C>current_step)
                speedC=pre_current_C+current_step;
            else if(speedC-pre_current_C<-current_step)
                speedC=pre_current_C-current_step;
        }
        if(abs(speedD-pre_current_D)>current_step)
        {
            if(speedD-pre_current_D>current_step)
                speedD=pre_current_D+current_step;
            else if(speedD-pre_current_D<-current_step)
                speedD=pre_current_D-current_step;
        }
        current_sum=fabs(speedA)+fabs(speedB)+fabs(speedC)+fabs(speedD);



        if(current_sum > max_output_current)
        {
            speedA*=(max_output_current)/current_sum;
            speedB*=(max_output_current)/current_sum;
            speedC*=(max_output_current)/current_sum;
            speedD*=(max_output_current)/current_sum;
        }
        CAN1_Send_Bottom(speedA,speedB,speedC,speedD);
    }

    output_current_sum=abs(speedA)+abs(speedB)+abs(speedC)+abs(speedD);
    pre_current_A=speedA;
    pre_current_B=speedB;
    pre_current_C=speedC;
    pre_current_D=speedD;


}


/**********  底盘电机幅值限制  **********/
float CMSpeedLegalize(float MotorCurrent , float limit)
{
    return MotorCurrent<-limit?-limit:(MotorCurrent>limit?limit:MotorCurrent);
}


/***************************************************************************************
 *Name     : followValCal
 *Function ：底盘电机跟随计算
 *Input    ：Setposition,Yaw轴电机码盘跟随值
 *Output   ：底盘跟随量
 *Description : 底盘电机跟随量计算函数
****************************************************************************************/
int16_t followValCal(float Setposition)
{
    int16_t followVal = 0;
    float NowPosition = position_yaw_relative;
    followVal=PID_ControllerDriver(&SPFOLLOW,Setposition,NowPosition);
//	float followVal_speed=PID_ControllerDriver(&SPFOLLOW_SPEED,followVal/20.0,yaw_speed);
//	followVal = CMSpeedLegalize(followVal_speed,1200);
    //跟随量最小值，角度过小不跟随
    //if(abs(followVal) < followVal_limit) followVal = 0;

    return followVal;
}



/*-------------  底盘电机速度PID和跟随PID初始化  -------------*/



/*底盘初始化*/
void CMControlInit(void)
{
    PID_ControllerInit(&SPFOLLOW,50,150,1100,0.01);
    SPFOLLOW.intergration_separation = 100;
		int16_t max_out = 5000; //this is the value to saturate the wheels' PID output
    PID_ControllerInit(&SPCHIASSISA,500,100,max_out,0.001);
    PID_ControllerInit(&SPCHIASSISB,500,100,max_out,0.001);
    PID_ControllerInit(&SPCHIASSISC,20,20,max_out,0.001);
    PID_ControllerInit(&SPCHIASSISD,20,20,max_out,0.001);
    PID_ControllerInit(&SPFOLLOW_SPEED,20,20,1500,0.001);
    PID_SetGains(&SPFOLLOW, 0.29,0.3,0.004);// 0.28,0.3,0.8
    PID_SetGains(&SPFOLLOW_SPEED,3,0.5,0.1);
    CM_Normal_PID();
		
		PID_ControllerInit(&ChassiPitchPID.Position,1000,500,8000,0.01);
    PID_ControllerInit(&ChassiPitchPID.Speed,50,50,8000,0.01);
		PID_SetGains(&ChassiPitchPID.Position,pp,pi,pd);
    PID_SetGains(&ChassiPitchPID.Speed,sp,si,sd);
	
}

void CM_Normal_PID(void)
{
    PID_SetGains(&SPCHIASSISA,cm_normal_p,cm_normal_i,cm_normal_d);
    PID_SetGains(&SPCHIASSISB,cm_normal_p,cm_normal_i,cm_normal_d);
    PID_SetGains(&SPCHIASSISC,cm_normal_p,cm_normal_i,cm_normal_d);
    PID_SetGains(&SPCHIASSISD,cm_normal_p,cm_normal_i,cm_normal_d);
	PID_SetGains(&SPFOLLOW, 0.29,0.3,0.004);// 0.28,0.3,0.8
}

void CM_Climb_PID(void)
{
    PID_SetGains(&SPCHIASSISA,cm_climb_p,cm_climb_i,cm_climb_d);
    PID_SetGains(&SPCHIASSISB,cm_climb_p,cm_climb_i,cm_climb_d);
    PID_SetGains(&SPCHIASSISC,cm_climb_p,cm_climb_i,cm_climb_d);
    PID_SetGains(&SPCHIASSISD,cm_climb_p,cm_climb_i,cm_climb_d);
	PID_SetGains(&SPFOLLOW, 0.23,0.3,0.002);// 0.28,0.3,0.8
}


void keyboardmove(uint16_t keyboardvalue,uint16_t xlimit,uint16_t ylimit)
{

    // W and S
    switch(keyboardvalue & (KEY_PRESSED_OFFSET_W|KEY_PRESSED_OFFSET_S))
    {
    case ( KEY_PRESSED_OFFSET_W):
        m = 0;
        if(keymove_y>0)
            keymove_y += 0.8f*step;
        else
            keymove_y += step*2;
        break;
    case ( KEY_PRESSED_OFFSET_S):
        m = 0;
        if(keymove_y<0)
            keymove_y -= 0.8f*step;
        else
            keymove_y -= step*2;
        break;
    default:
        m++;
        if(m>1)
        {
            if(keymove_y>3*step) {
                keymove_y=keymove_y-3*step;
            }
            else if(keymove_y<-3*step) {
                keymove_y=keymove_y+3*step;
            }
            else {
                keymove_y = 0;
            }
        }
        break;
    }

    //  A and D  stand for X axis
    switch(keyboardvalue & (KEY_PRESSED_OFFSET_A | KEY_PRESSED_OFFSET_D))
    {
    case ( KEY_PRESSED_OFFSET_A):
        n = 0;
        if(keymove_x<0)
            keymove_x -= 3*step;
        else
            keymove_x -= 3*step;
        break;
    case ( KEY_PRESSED_OFFSET_D):
        n = 0;
        if(keymove_x>0)    //正在向右
            keymove_x += 3*step;           //加步长
        else
            keymove_x += 3*step;
        break;

    default:
        n++;
        if(n>1)
        {
            if(keymove_x>3*step) {
                keymove_x=keymove_x-3*step;
            }
            else if(keymove_x<-3*step) {
                keymove_x=keymove_x+3*step;
            }
            else {
                keymove_x = 0;
            }
        }
        break;
    }
    keymove_x = keymove_x>xlimit?xlimit:(keymove_x<-xlimit?-xlimit:keymove_x);  //限速
    keymove_y = keymove_y>ylimit?ylimit:(keymove_y<-ylimit?-ylimit:keymove_y);

    if(keymove_x<5&&keymove_x>-5) keymove_x = 0;
    if(keymove_y<5&&keymove_y>-5) keymove_y = 0;	 //减少爬行

}

u8 cm_switch_delay=0;


int rotate_shift_count=0;
void CM_Switch_Moni(void)
{
    if(cm_switch_delay>0)
        cm_switch_delay--;


    if((RC_Ex_Ctl.key.v & KEY_PRESSED_OFFSET_X )==KEY_PRESSED_OFFSET_X&&cm_switch_delay<=0)
    {
        if(climb_mode_flag==1)
            climb_mode_flag=0;
        else
            climb_mode_flag=1;
        cm_switch_delay=50;
    }

    if(	rotate_shift_count>-1)
    {
        rotate_shift_count--;
    }

    if((RC_Ex_Ctl.key.v & KEY_PRESSED_OFFSET_SHIFT )==KEY_PRESSED_OFFSET_SHIFT)
    {
        rotate_shift_count=50;
    }
    if(rotate_shift_count==0&&(RC_Ex_Ctl.key.v & KEY_PRESSED_OFFSET_SHIFT )!=KEY_PRESSED_OFFSET_SHIFT)
    {
        rotate_speed_dir=-rotate_speed_dir;
    }


}




